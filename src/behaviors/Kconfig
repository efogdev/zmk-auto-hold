## src/behaviors/Kconfig
```kconfig
config ZMK_BEHAVIOR_AUTO_HOLD_TIMEOUT_MS
    int "Default auto-hold timeout in milliseconds"
    default 2000

config ZMK_BEHAVIOR_AUTO_HOLD_ANYKEY_INTERRUPT
    bool "Interrupt auto-hold whenever any button is pressed"
    default n

config ZMK_BEHAVIOR_AUTO_HOLD_MAX_BEHAVIORS
    int "Maximum auto hold instances"
    default 4
```
