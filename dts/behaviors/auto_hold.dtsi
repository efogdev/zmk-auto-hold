/ {
	behaviors {
		ah: auto_hold {
			compatible = "zmk,behavior-auto-hold";
			display-name = "Auto hold keyboard key";
			#binding-cells = <1>;
			bindings = <&kp>;
		};

		mah: mouse_auto_hold {
			compatible = "zmk,behavior-auto-hold";
			display-name = "Auto hold mouse key";
			#binding-cells = <1>;
			bindings = <&mkp>;
		};
	};
};
